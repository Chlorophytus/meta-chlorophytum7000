## conf/layer.conf
```bitbake
# We have a conf and classes directory, add to BBPATH
BBPATH .= ":${LAYERDIR}"

# We have recipes-* directories, add to BBFILES
BBFILES += "${LAYERDIR}/recipes-*/*/*.bb \
            ${LAYERDIR}/recipes-*/*/*.bbappend"

BBFILE_COLLECTIONS += "meta-chlorophytum7000"
BBFILE_PATTERN_meta-chlorophytum7000 = "^${LAYERDIR}/"
BBFILE_PRIORITY_meta-chlorophytum7000 = "6"

LAYERDEPENDS_meta-chlorophytum7000 = "core"
LAYERSERIES_COMPAT_meta-chlorophytum7000 = "hardknott"
```

## conf/machine/chlorophytum7000.conf
```bitbake
require conf/machine/include/soc-zynq.inc
require conf/machine/include/machine-xilinx-default.inc

MACHINE_FEATURES = "vfat serial usbhost usbgadget"
IMAGE_FSTYPES = "btrfs"
IMAGE_BOOT_FILES += "zImage;boot/"
SERIAL_CONSOLES ?= "115200;ttyPS0"
```
